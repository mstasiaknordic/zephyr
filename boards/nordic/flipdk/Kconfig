## boards/nordic/flipdk/Kconfig
```kconfig
# FLIP emulated board configuration

# Copyright (c) 2024 Nordic Semiconductor ASA
# SPDX-License-Identifier: Apache-2.0

if BOARD_FLIPDK_FLIP_CPUAPP

config BOARD_ENABLE_DCDC
	bool "DCDC mode"
	select SOC_NRF54L_VREG_MAIN_DCDC
	default y

endif # BOARD_FLIPDK_FLIP_CPUAPP
```

## boards/nordic/flipdk/Kconfig.defconfig
```kconfig
# Copyright (c) 2024 Nordic Semiconductor ASA
# SPDX-License-Identifier: Apache-2.0

if BOARD_FLIPDK_FLIP_CPUAPP

config BT_CTLR
	default BT

config ROM_START_OFFSET
	default 0x800 if BOOTLOADER_MCUBOOT

endif # BOARD_FLIPDK_FLIP_CPUAPP
```

## boards/nordic/flipdk/Kconfig.flipdk
```kconfig
# Copyright (c) 2024 Nordic Semiconductor ASA
# SPDX-License-Identifier: Apache-2.0

config BOARD_FLIPDK
	select SOC_FLIP_ENGA_CPUAPP if BOARD_FLIPDK_FLIP_CPUAPP
	select SOC_FLIP_ENGA_CPUFLPR if BOARD_FLIPDK_FLIP_CPUFLPR
```

## drivers/dac/Kconfig.nrf
```kconfig
config DAC_NRF
	bool "NRF DAC driver"
	default y
	depends on DT_HAS_NORDIC_NRF_DAC_ENABLED
	help
	  Enable the driver implementation for the nRF DAC
```

## drivers/spi/Kconfig.nrfx_spi_instance
```kconfig
# nRF SPI(M/S) instance configuration

# Copyright (c) 2025 Nordic Semiconductor ASA
# SPDX-License-Identifier: Apache-2.0

config SPI_$(nrfx_spi_num)_HAS_CROSS_DOMAIN_PINS
	bool
	depends on (SOC_NRF54L05 || SOC_NRF54L10 || SOC_NRF54L15)
	default $(nrfx_spi_num) = 20 || $(nrfx_spi_num) = 21
	select NRFX_POWER if $(nrfx_spi_num) = 20 || $(nrfx_spi_num) = 21
	help
	  Option indicating whether SPI instance supports usage of pins
	  in domain different from the instance.
```

## dts/bindings/dac/nordic,nrf-dac.yaml
```yaml
# Copyright (c) 2018, Nordic Semiconductor ASA
# SPDX-License-Identifier: Apache-2.0

description: nRF DAC node

compatible: "nordic,nrf-dac"

include: dac-controller.yaml

properties:
  reg:
    required: true

  interrupts:
    required: true

  "#io-channel-cells":
    const: 1

io-channel-cells:
  - input
```

## soc/nordic/flip/Kconfig.defconfig.flip_cpuapp
```kconfig
# Nordic Semiconductor nRF54L15 MCU

# Copyright (c) 2024 Nordic Semiconductor ASA
# SPDX-License-Identifier: Apache-2.0

if SOC_FLIP_ENGA_CPUAPP

config NUM_IRQS
	int
	default 271

endif # SOC_FLIP_ENGA_CPUAPP
```
