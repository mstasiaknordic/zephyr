/*
 * Copyright (c) 2024 Nordic Semiconductor ASA
 *
 * SPDX-License-Identifier: Apache-2.0
 */

/dts-v1/;

#include "flip_cpuapp_common.dtsi"

/ {
	compatible = "nordic,flipdk_flip-cpuapp";
	model = "Nordic FLIP emulated board Application MCU";

	chosen {
		zephyr,code-partition = &slot0_partition;
		zephyr,sram = &cpuapp_sram;
	};
};
